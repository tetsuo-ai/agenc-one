## meta-agenc/conf/layer.conf
```bitbake
# Layer configuration for meta-agenc
BBPATH .= ":${LAYERDIR}"

BBFILES += " \
    ${LAYERDIR}/recipes-*/*/*.bb \
    ${LAYERDIR}/recipes-*/*/*.bbappend \
"

BBFILE_COLLECTIONS += "meta-agenc"
BBFILE_PATTERN_meta-agenc = "^${LAYERDIR}/"
BBFILE_PRIORITY_meta-agenc = "10"

LAYERDEPENDS_meta-agenc = "core raspberrypi openembedded-layer meta-python networking-layer"
LAYERSERIES_COMPAT_meta-agenc = "scarthgap styhead"
```

## meta-agenc/conf/machine/agenc-one.conf
```bitbake
#@TYPE: Machine
#@NAME: AGENC ONE
#@DESCRIPTION: AGENC ONE AI Agent Device based on Raspberry Pi Zero 2W

# Base machine
require conf/machine/raspberrypi0-2w-64.conf

# Device identity
MACHINE_EXTRA_RRECOMMENDS += "agenc-runtime agenc-config"

# Display: 1.69" SPI (ST7789)
ENABLE_SPI_BUS = "1"
RPI_EXTRA_CONFIG += "dtoverlay=spi0-1cs\ndtoverlay=st7789v"

# Audio: WM8960 I2S codec on WhisPlay HAT
MACHINE_EXTRA_RRECOMMENDS += "alsa-utils alsa-lib"
RPI_EXTRA_CONFIG += "dtoverlay=wm8960-soundcard\ndtparam=i2c_arm=on"

# GPIO: libgpiod for button input
MACHINE_EXTRA_RRECOMMENDS += "libgpiod libgpiod-tools"

# WiFi firmware
MACHINE_EXTRA_RRECOMMENDS += "linux-firmware-rpidistro-bcm43436 linux-firmware-rpidistro-bcm43436s"

# Serial console for debug builds only
SERIAL_CONSOLES = "115200;ttyS0"

# GPU memory split - minimal, no desktop
GPU_MEM = "16"

# Disable Pi GPU rainbow — our psplash shows the AGENC logo instead
DISABLE_OVERSCAN = "1"
DISABLE_SPLASH = "1"

# Silent boot: suppress kernel messages so splash stays clean
CMDLINE:append = " quiet loglevel=0 logo.nologo vt.global_cursor_default=0"

# Kernel modules
KERNEL_MODULE_AUTOLOAD += "spi-bcm2835 snd-usb-audio"
```

## meta-agenc/wic/agenc-os.wks
```
# AgenC OS Partition Layout for Pi Zero 2W
# p1: boot (FAT32) - kernel, DTBs, firmware
# p2: rootfs A (ext4, read-only) - active system
# p3: rootfs B (ext4, read-only) - OTA slot
# p4: data (ext4, read-write) - agent state, logs, env, keystore

part /boot --source bootimg-partition --ondisk mmcblk0 --fstype=vfat --label boot --active --align 4096 --size 64
part / --source rootfs --ondisk mmcblk0 --fstype=ext4 --label rootfs-a --align 4096 --size 512
part --ondisk mmcblk0 --fstype=ext4 --label rootfs-b --align 4096 --size 512
part /data --ondisk mmcblk0 --fstype=ext4 --label data --align 4096 --size 256
```
